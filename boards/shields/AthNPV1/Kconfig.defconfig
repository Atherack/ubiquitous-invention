## boards/shields/AthNPV1/Kconfig.defconfig
```kconfig
if SHIELD_AthNPV1

# Name must be less than 16 characters long!
config ZMK_AthNPV1
    default "AthNumPad V1"

endif
```

## boards/shields/AthNPV1/Kconfig.shield
```kconfig
# No whitespace after the comma or in your keyboard name!
config SHIELD_AthNPV1
    def_bool $(shields_list_contains,AthNPV1)
```
